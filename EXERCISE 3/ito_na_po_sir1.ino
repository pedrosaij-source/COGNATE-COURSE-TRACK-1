#include <Keypad.h>

char keys[4][4]={
  {'1','2','3','A'},
  {'4','5','6','B'},
  {'7','8','9','C'},
  {'*','0','#','D'}
};

byte r[]={9,8,7,6}, c[]={5,4,3,2};
Keypad k=Keypad(makeKeymap(keys),r,c,4,4);

int seg[]={A0,A1,A2,A3,A4,A5,10};

byte p[14][7]={
 {1,1,1,1,1,1,0},{0,1,1,0,0,0,0},{1,1,0,1,1,0,1},
 {1,1,1,1,0,0,1},{0,1,1,0,0,1,1},{1,0,1,1,0,1,1},
 {1,0,1,1,1,1,1},{1,1,1,0,0,0,0},{1,1,1,1,1,1,1},
 {1,1,1,1,0,1,1},{1,1,1,0,1,1,1},{0,0,1,1,1,1,1},
 {1,0,0,1,1,1,0},{0,1,1,1,1,0,1}
};

void setup(){
  for(int i=0;i<7;i++) pinMode(seg[i],OUTPUT);
}

void loop(){
  char x=k.getKey();
  if(x>='0'&&x<='9') show(x-'0');
  else if(x>='A'&&x<='D') show(x-'A'+10);
}

void show(int n){
  for(int i=0;i<7;i++) digitalWrite(seg[i],p[n][i]);
}